## sdkconfig.defaults
```kconfig
CONFIG_FREERTOS_QUEUE_REGISTRY_SIZE=4
CONFIG_FREERTOS_ISR_STACKSIZE=2100

CONFIG_FREERTOS_TIMER_QUEUE_LENGTH=20
CONFIG_FREERTOS_TIMER_TASK_STACK_DEPTH=4096
# the following line will be removed for production
CONFIG_FREERTOS_USE_TRACE_FACILITY=y

# CONFIG_LOG_DEFAULT_LEVEL_NONE=y
CONFIG_LOG_DEFAULT_LEVEL=3

# Enable HTTPS Server
CONFIG_ESP_HTTPS_SERVER_ENABLE=y

# ESP-TLS
# CONFIG_ESP_TLS_USING_MBEDTLS is not set
CONFIG_ESP_TLS_USING_WOLFSSL=y
CONFIG_ESP_TLS_SERVER=y
# CONFIG_ESP_TLS_PSK_VERIFICATION is not set
CONFIG_ESP_WOLFSSL_SMALL_CERT_VERIFY=y
CONFIG_ESP_DEBUG_WOLFSSL=y

CONFIG_HAP_FACTORY_NVS_OFFSET=0x510000
CONFIG_HAP_MFI_ENABLE=n
CONFIG_RELEASE_BUILD=y
CONFIG_ESP32_WIFI_NVS_ENABLED=y
CONFIG_HTTPD_WS_SUPPORT=y

#C++ features and compiler options
CONFIG_COMPILER_CXX_RTTI=y
CONFIG_COMPILER_CXX_EXCEPTIONS=y

# Use custom partition table
# CONFIG_PARTITION_TABLE_SINGLE_APP is not set
# CONFIG_PARTITION_TABLE_TWO_OTA is not set
CONFIG_PARTITION_TABLE_CUSTOM=y
CONFIG_PARTITION_TABLE_CUSTOM_FILENAME="partitions_hap.csv"
CONFIG_PARTITION_TABLE_OFFSET=0x8000
CONFIG_PARTITION_TABLE_MD5=y
# CONFIG_ESPTOOLPY_FLASHSIZE_2MB is not set
CONFIG_ESPTOOLPY_FLASHSIZE_16MB=y
CONFIG_ESPTOOLPY_FLASHSIZE="16MB"

CONFIG_LWIP_MAX_SOCKETS=16

CONFIG_RSSI_VALUE=56

# ota update - skip version checking for debug purposes
CONFIG_EXAMPLE_SKIP_VERSION_CHECK=y
```
